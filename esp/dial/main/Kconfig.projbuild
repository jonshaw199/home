## esp/dial/main/Kconfig.projbuild
```kconfig
menu "Home Config"
config DEVICE_ID
    string "Device ID"
    default "c614b958-9a78-4b0f-8c2f-727a36e40b1c"
    help
      Set a unique ID for the device.

config WIFI_SSID
    string "Wi-Fi SSID"
    default "default_ssid"
    help
      Set the Wi-Fi SSID for the device.

config WIFI_PASSWORD
    string "Wi-Fi Password"
    default "default_password"
    help
      Set the Wi-Fi password for the device.

config MQTT_BROKER
    string "MQTT Broker Host"
    default "mqtt://home.com"
    help
      Set the MQTT broker host.
endmenu
```

## esp/environmental/main/Kconfig.projbuild
```kconfig
menu "Home Config"
config DEVICE_ID
    string "Device ID"
    default "ae84ac05-0d32-40b0-9703-a12e479764bd"
    help
      Set a unique ID for the device.

config WIFI_SSID
    string "Wi-Fi SSID"
    default "default_ssid"
    help
      Set the Wi-Fi SSID for the device.

config WIFI_PASSWORD
    string "Wi-Fi Password"
    default "default_password"
    help
      Set the Wi-Fi password for the device.

config MQTT_BROKER
    string "MQTT Broker Host"
    default "mqtt://localhost"
    help
      Set the MQTT broker host.
endmenu
```
